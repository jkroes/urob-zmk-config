// TODO Adapt this layout for MacOS

#include <behaviors.dtsi>
#include <dt-bindings/zmk/keys.h>
#ifdef CONFIG_WIRELESS
  #include <dt-bindings/zmk/bt.h>
  #include <dt-bindings/zmk/outputs.h>
  #define _BT_SEL_KEYS_                                                        \
      &bt BT_SEL 0 &bt BT_SEL 1 &bt BT_SEL 2 &bt BT_SEL 3 &bt BT_CLR
#else
  #define _BT_SEL_KEYS_ &trans &trans &trans &trans &trans
#endif
#include "zmk-helpers/helper.h"

#define DEF 0
#define PC  1
#define NAV 2
#define FN  3
#define NUM 4
#define SYS 5

#define TAP_TERM 150

#define QUICK_TAP_MS (TAP_TERM + 150)

#define PINKY_TAP_TERM (TAP_TERM + 150)
#define RINGY_TAP_TERM (TAP_TERM + 125)
#define MIDDY_TAP_TERM (TAP_TERM + 100)
#define INDEX_TAP_TERM (TAP_TERM + 75)

#define HOME_ROW_PINKY_KEY LCTRL
#define HOME_ROW_RING_KEY LALT
#define HOME_ROW_MIDDLE_KEY LSHFT
#define HOME_ROW_INDEX_KEY LGUI

#define HOME_ROW_PINKY_KEY_PC HOME_ROW_INDEX_KEY
#define HOME_ROW_INDEX_KEY_PC HOME_ROW_PINKY_KEY


&sk {
  release-after-ms = <900>;
  quick-release;
};

&sl { // Allow sticky mods to chord across sticky layers.
  ignore-modifiers;
};

&lt {
  flavor = "balanced";
  tapping-term-ms = <300>;
  quick-tap-ms = <QUICK_TAP_MS>;
};

#include "homerow_mods.dtsi"
#include "morphs.dtsi"
#include "base_thumbs.dtsi" // Must be sourced after SIMPLE_MORPH is defined
#include "nav.dtsi"
#include "app_switcher.dtsi"
#include "fn.dtsi"
#include "leader.dtsi"
#include "combos.dtsi" // Must be sourced after &hml and &hmr are defined

#define XXX &none
#define ___ &trans

ZMK_CONDITIONAL_LAYER(sys, FN NUM, SYS) // FN + NUM --> SYS.

GLV80_LAYER(macos,
&tog 1       &kp F2  &kp F3  &kp F4     &kp F5                        &kp F6     &kp F7        &kp F8      &kp F9   &kp F10 
XXX          &kp N1  &kp N2  &kp N3     &kp N4      &kp N5    &kp N6  &kp N7     &kp N8        &kp N9      &kp N0   XXX  
XXX          &kp Q   &kp W   &kp E      &kp R       &kp T     &kp Y   &kp U      &kp I         &kp O       &kp P    XXX
&kp CAPS     lp(A)   lr(S)   lm(D)      li(F)       &kp G     &kp H   ri(J)      rm(K)         rr(L)       rp(SQT)  XXX
XXX          &kp Z   &kp X   &kp C      &kp V       &kp B   , &kp N   &kp M      &comma_morph  &dot_morph  &qexcl   XXX
&bootloader  XXX     XXX     &kp LEFT   &kp RIGHT           ,         &kp UP     &kp DOWN      XXX         XXX      &bootloader

,                            &kp LGUI   &kp LSHFT   &kp LALT  XXX     XXX        XXX      
,                            SUPER_NAV  &lt FN TAB  XXX       XXX     SMART_NUM  MAGIC_SHIFT
)

GLV80_LAYER(pc,
___  ___       ___       ___        ___                  ___       ___    ___       ___         ___
___  ___       ___       ___        ___       ___   ___  ___       ___    ___       ___         ___
___  ___       ___       ___        ___       ___   ___  ___       ___    ___       ___         ___
___  lp_pc(A)  lr_pc(S)  lm_pc(D)   li_pc(F)  ___   ___  ri_pc(J)  rm(K)  rr_pc(L)  rp_pc(SQT)  ___
___  ___       ___       ___        ___       ___ , ___  ___       ___    ___       ___         ___
___  ___       ___       ___        ___           ,      ___       ___    ___       ___         ___

,                        &kp LCTRL  ___       ___   ___  ___       ___
,                        ___        ___       ___   ___  ___       ___
)

GLV80_LAYER(nav,
XXX  XXX         XXX       XXX          XXX                         XXX       XXX       XXX        XXX      XXX
XXX  XXX         XXX       XXX          XXX       XXX   XXX         XXX       XXX       XXX        XXX      XXX
XXX  &kp LA(F4)  XXX       &kp LS(TAB)  &swapper  XXX   &kp  PG_UP  NAV_BSPC  NAV_UP    NAV_DEL    XXX      XXX 
XXX  &sk LCTRL   &sk LALT  &sk LSHFT    &sk LGUI  XXX , &kp  PG_DN  NAV_LEFT  NAV_DOWN  NAV_RIGHT  &kp RET  XXX 
XXX  XXX         XXX       XXX          XXX       XXX , &kp  INS    &kp TAB   XXX       XXX        XXX      XXX
XXX  XXX         XXX       XXX          XXX                         XXX       XXX       XXX        XXX      XXX

,                          ___          ___       ___   ___         ___       ___
,                          ___          ___       ___   ___         ___       CANCEL
)

GLV80_LAYER(fn,
XXX  XXX  XXX  XXX  XXX             XXX  XXX  XXX  XXX  XXX
XXX  XXX  XXX  XXX  XXX  XXX   XXX  XXX  XXX  XXX  XXX  XXX
XXX  XXX  XXX  XXX  XXX  XXX   XXX  XXX  XXX  XXX  XXX  XXX
XXX  XXX  XXX  XXX  XXX  XXX   XXX  XXX  XXX  XXX  XXX  XXX
XXX  XXX  XXX  XXX  XXX  XXX , XXX  XXX  XXX  XXX  XXX  XXX
XXX  XXX  XXX  XXX  XXX      ,      XXX  XXX  XXX  XXX  XXX

,              ___  ___  ___   ___  ___  ___
,              ___  ___  ___   ___  ___  ___
)

GLV80_LAYER(num,
XXX  XXX  XXX  XXX  XXX             XXX  XXX  XXX  XXX  XXX
XXX  XXX  XXX  XXX  XXX  XXX   XXX  XXX  XXX  XXX  XXX  XXX
XXX  XXX  XXX  XXX  XXX  XXX   XXX  XXX  XXX  XXX  XXX  XXX
XXX  XXX  XXX  XXX  XXX  XXX   XXX  XXX  XXX  XXX  XXX  XXX
XXX  XXX  XXX  XXX  XXX  XXX , XXX  XXX  XXX  XXX  XXX  XXX
XXX  XXX  XXX  XXX  XXX      ,      XXX  XXX  XXX  XXX  XXX

,              ___  ___  ___   ___  ___  ___
,              ___  ___  ___   ___  ___  ___
)

GLV80_LAYER(sys,
XXX  XXX  XXX  XXX  XXX             XXX  XXX  XXX  XXX  XXX
XXX  XXX  XXX  XXX  XXX  XXX   XXX  XXX  XXX  XXX  XXX  XXX
XXX  XXX  XXX  XXX  XXX  XXX   XXX  XXX  XXX  XXX  XXX  XXX
XXX  XXX  XXX  XXX  XXX  XXX   XXX  XXX  XXX  XXX  XXX  XXX
XXX  XXX  XXX  XXX  XXX  XXX , XXX  XXX  XXX  XXX  XXX  XXX
XXX  XXX  XXX  XXX  XXX      ,      XXX  XXX  XXX  XXX  XXX

,              ___  ___  ___   ___  ___  ___
,              ___  ___  ___   ___  ___  ___
)

/*
enable private relay on mac mini if not enabled
on macos, i can swap the modifiers for specific keyboards. keep the windows bindings here and swap cmd/ctrl
look into https://karabiner-elements.pqrs.org and https://www.reddit.com/r/vim/comments/c4oyji/if_youre_on_macos_karabiners_systemwide_vimode_is/

Navigation:
Arrows
LA(l/r): move word
LG(l/r): move start/end line
LA(u/d): move paragraph
page up/down
HOME/END
shift + arrows = select ...
Get rid of caps once hammerspoon becomes redundant
Note that some things are best implemented as combos!!!
bind pc-specific layers to the thumb clusters on the pc layer

system shortcuts (change to fn keys or hyper--all mods--to 
avoid interfering with app shortcuts):

https://alt-tab-macos.netlify.app
https://rectangleapp.com
https://www.reddit.com/r/macapps/comments/1dmj0la/spaces_for_macos/
Assign apps to specific mission control spaces: https://support.apple.com/ml-in/guide/mac-help/mh14112/mac

1password (on laptop: cmd-shift-spc)
app switcher (cmd-tab, needs arrows and tab in new layer)
spotlight
- show spotlight search
- show finder search window
launchpad & dock
- show launchpad
mission control
- mission control: show all windows?
- move left/right a space 
- application windows 
- show desktop
windows
- minimize
- maximize
- fill
- center
- halves 
keyboard
- move focus to next window
- move focus to the dock
- move focus to the menu bar
- show contextual menu: right click?
-- maybe we can simulate this with zmk mouse functionality I deleted?
cmd-shift-5: screenshot toolbar
TODO services
dictation 
safari tab overview (cmd-shift-\)
enable type to siri shortcut: tap cmd twice (requires standalone cmd key)
*/