#include <behaviors/num_word.dtsi> // Requires auto-layer module.

// Tap: bspc | Hold: nav layer | Shift-hold: toggle nav layer
ZMK_HOLD_TAP(bspc_del, bindings = <&mo>, <&bspc_del_morph>; 
             flavor = "balanced"; tapping-term-ms = <INDEX_TAP_TERM>; 
             quick-tap-ms = <200>;)
ZMK_MOD_MORPH(bspc_del_morph, bindings = <&kp BSPC>, <&kp DEL>; mods = <(MOD_LCTL|MOD_LGUI)>;)

// Tap: ret | Hold: num layer | Shift-hold: num-word 
ZMK_HOLD_TAP(num, 
             bindings = <&num_morph>, <&kp>; 
             flavor = "balanced"; 
             tapping-term-ms = <INDEX_TAP_TERM>; 
             quick-tap-ms = <200>;)
SIMPLE_MORPH(num_morph, SFT, &mo NUM, &num_word NUM)

// Tap: space
// Right shift-tap (after alpha): dot -> space -> sticky shift | 
// Hold: shift
// Shift-hold: caps-word 
ZMK_HOLD_TAP(shift_spc_tab, 
             bindings = <&shift_caps>, <&spc_tab>;
             flavor = "balanced"; 
             tapping-term-ms = <INDEX_TAP_TERM>;
             quick-tap-ms = <200>;)

#define WITH_TYPING(NAME, BINDING) \
  ZMK_MACRO(NAME, bindings = \
              <&macro_press &mo TYPING BINDING>, \
              <&macro_pause_for_release>, \
              <&macro_release &mo TYPING BINDING>; \
            wait-ms = <0>; tap-ms = <5>;)
//ZMK_MACRO(flush_mods, 
//          bindings = <&kp LSHFT &kp RSHFT &kp LCTRL &kp RCTRL 
//                      &kp LALT &kp RALT &kp LGUI &kp RGUI>; 
//          wait-ms = <0>; 
//          tap-ms = <5>;)
WITH_TYPING(shift_typing, &kp LSHFT)
WITH_TYPING(caps_word_typing, &caps_word)
SIMPLE_MORPH(shift_caps, SFT, &shift_typing, &caps_word_typing)

ZMK_MOD_MORPH(spc_tab, bindings = <&kp SPACE>, <&kp TAB>; mods = <(MOD_RCTL|MOD_RGUI)>;)
//ZMK_MACRO(dot_spc, bindings = <&kp DOT &kp SPACE &sk LSHFT>; wait-ms = <0>; tap-ms = <5>;)

