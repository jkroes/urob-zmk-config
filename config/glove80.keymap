#include "zmk-helpers/key-labels/glove80.h" // Key position labels
#define THUMBS LH0 LH1 LH2 LH3 LH4 LH5 \
               RH0 RH1 RH2 RH3 RH4 RH5
#define KEYS_L LC1 LC2 LC3 LC4 LC5     \
               LN0 LN1 LN2 LN3 LN4 LN5 \
               LT0 LT1 LT2 LT3 LT4 LT5 \
               LM0 LM1 LM2 LM3 LM4 LM5 \
               LB0 LB1 LB2 LB3 LB4 LB5 \
               LF1 LF2 LF3 LF4 LF5
#define KEYS_R RC1 RC2 RC3 RC4 RC5     \
               RN0 RN1 RN2 RN3 RN4 RN5 \
               RT0 RT1 RT2 RT3 RT4 RT5 \
               RM0 RM1 RM2 RM3 RM4 RM5 \
               RB0 RB1 RB2 RB3 RB4 RB5 \
               RF1 RF2 RF3 RF4 RF5
#include <behaviors.dtsi>
#include <dt-bindings/zmk/keys.h>
#include <dt-bindings/zmk/bt.h>
#include <dt-bindings/zmk/outputs.h>
// TODO Add back Sys layer with bluetooth, bootloader, sys_reset
// #define _BT_SEL_KEYS_ &bt BT_SEL 0 &bt BT_SEL 1 &bt BT_SEL 2 &bt BT_SEL 3 &bt BT_CLR
#include "zmk-helpers/helper.h"
#include <behaviors/num_word.dtsi> // Requires auto-layer module

// _CAT and CAT both paste or concatenate arguments.
// Prescan expands each macro argument before substitution unless the corresponding parameter is
// used with # or ## in that same macro. Substitution replaces a macro with its body
// and its arguments with their (possibly expanded) value. The process repeats
// recusrively for inner macros within the body.
//   #define _SUFFIX _pc
//   _CAT(swapper, _pc)     → swapper_pc   (non-macro tokens)
//   _CAT(swapper, _SUFFIX) → swapper_SUFFIX  (macro was NOT expanded before paste)
//   CAT(swapper, _SUFFIX)  → swapper_pc (macro was expanded before paste)
// Inside an outer macro that doesn’t use #/## with its parameters, using _CAT
// or CAT at the call sites yields the same result because the outer prescan
// already expanded the args.
// If you ever paste at top level or inside a macro where the pasting macro is
// the first to see those arguments, use CAT to ensure arguments expand before
// they’re glued together.
#define _CAT(a,b) a##b
#define CAT(a,b) _CAT(a,b)

// Maps layers in top to bottom order to order-independent names 
#define DEF    0
#define PC     1
#define TYPING 2
#define NAV    3
#define NAV_PC 4
#define SYM    5
#define NUM    6
#define SYS    7

#define SWAPPER_POS RM1 RM2 RM3 RM4 RH5 // Continue &swapper on NAV_LEFT NAV_UP NAV_DOWN NAV_RIGHT LS(TAB) 

// CONFIG_* symbols are Kconfig (C build-time) values, not Devicetree tokens. 
// The DTS preprocessor that feeds dtc doesn’t know about CONFIG_ZMK_*
// definitions, so I need to supply my own definitions for use with MACRO
#define MACRO_DEFAULT_WAIT_MS 15 // CONFIG_ZMK_MACRO_DEFAULT_WAIT_MS
#define MACRO_DEFAULT_TAP_MS 30 // CONFIG_ZMK_MACRO_DEFAULT_TAP_MS

#define COMBO_TIMEOUT_HORZ 40
#define COMBO_PRIOR_IDLE_HORZ 150
#define COMBO_TIMEOUT_VERT 75
#define COMBO_PRIOR_IDLE_VERT 50

// Minimum tapping-term-ms
#define MIN_TAP_TERM 150 

// Per-finger tapping-term-ms
#define PINKY_TAP_TERM 300 //(MIN_TAP_TERM + 150) 
#define RINGY_TAP_TERM 300 //(MIN_TAP_TERM + 125)
#define MIDDY_TAP_TERM 300 //(MIN_TAP_TERM + 100)
#define INDEX_TAP_TERM 300 //(MIN_TAP_TERM + 75)

#define XXX &none
#define ___ &trans

#include "my_behaviors.dtsi"
#include "combos.dtsi"  
//#include "leader.dtsi"
#include "macos.dtsi"
#include "nav.dtsi"

ZMK_CONDITIONAL_LAYER(sys, NUM SYM, SYS) // FN + NUM --> SYS.
ZMK_CONDITIONAL_LAYER(nav_pc, PC NAV, NAV_PC) 

GLV80_LAYER(macos,
&kp F1    &kp F2  &kp F3  &kp F4            &kp F5                          &kp F6       &kp F7        &kp F8      &kp F9   &kp F10 
XXX       &kp N1  &kp N2  &kp N3            &kp N4      &kp N5      &kp N6  &kp N7       &kp N8        &kp N9      &kp N0   XXX  
XXX       &kp Q   &kp W   &kp E             &kp R       &kp T       &kp Y   &kp U        &kp I         &kp O       &kp P    XXX
&kp CAPS  lp(A)   lr(S)   lm(D)             li(F)       &kp G       &kp H   ri(J)        rm(K)         rr(L)       rp(SQT)  XXX
XXX       &kp Z   &kp X   &kp C             &kp V       &kp B     , &kp N   &kp M        &comma_morph  &dot_morph  &qexcl   XXX
XXX       XXX     XXX     &kp LEFT          &kp RIGHT             ,         &kp UP       &kp DOWN      XXX         XXX      XXX
,                         &mt LCTRL TAB     XXX         XXX         XXX     XXX          &kp ESC
,                         LT_BSPC_DEL(NAV)  &num_morph  XXX         XXX     &lt SYM RET  &SHIFT_SPC
)

GLV80_LAYER(pc,
___  ___  ___  ___  ___             ___  ___  ___  ___  ___
___  ___  ___  ___  ___  ___   ___  ___  ___  ___  ___  ___
___  ___  ___  ___  ___  ___   ___  ___  ___  ___  ___  ___
___  ___  ___  ___  ___  ___   ___  ___  ___  ___  ___  ___
___  ___  ___  ___  ___  ___ , ___  ___  ___  ___  ___  ___
___  ___  ___  ___  ___      ,      ___  ___  ___  ___  ___
,              ___  ___  ___   ___  ___  ___
,              ___  ___  ___   ___  ___  ___
)

GLV80_LAYER(typing,
___  ___       ___       ___         ___                       ___       ___    ___       ___         ___
___  ___       ___       ___         ___       ___        ___  ___       ___    ___       ___         ___
___  ___       ___       ___         ___       ___        ___  ___       ___    ___       ___         ___
___  &kp A     &kp S     &kp D       &kp F     ___        ___  &kp J     &kp K  &kp L     &kp SQT     ___
___  ___       ___       ___         ___       ___      , ___  ___       ___    ___       ___         ___
___  ___       ___       ___         ___                ,      ___       ___    ___       ___         ___
,                        ___         ___       ___        ___  ___       ___
,                        ___         ___       ___        ___  ___       ___
)

// Remember that to activate the mod morphs on the right thumbs you need to use 
// the sticky modifiers on the left home row of the nav layer

GLV80_LAYER(nav,
XXX  XXX       XXX          XXX        XXX                       XXX        XXX        XXX         XXX        XXX
XXX  XXX       XXX          XXX        XXX        XXX   XXX      XXX        XXX        XXX         XXX        XXX
XXX  &kp DEL   &kp TAB      &kp BSPC   &kp SPC    XXX   XXX      &kp PG_UP  WORD_LEFT  WORD_RIGHT  &kp PG_DN  XXX 
XXX  &sk LGUI  &sk LALT     &sk LSHFT  &sk LCTRL  XXX   XXX      NAV_UP     NAV_LEFT   NAV_RIGHT   NAV_DOWN   XXX
XXX  &kp INS   &kp LS(TAB)  &kp ESC    &kp RET    XXX , XXX      XXX        XXX        XXX         XXX        XXX
XXX  XXX       XXX          XXX        XXX            ,          XXX        XXX        XXX         XXX        XXX
,                           ___        ___        ___   ___      ___        &kp LS(TAB)  
,                           ___        ___        ___   ___      NEXT_WIN   &swapper     
)                                                      

GLV80_LAYER(nav_pc,
___  ___  ___  ___  ___                   ___           ___           ___            ___          ___
___  ___  ___  ___  ___  ___   ___        ___           ___           ___            ___          ___
___  ___  ___  ___  ___  ___   ___        ___           WORD_LEFT_PC  WORD_RIGHT_PC  ___          ___
___  ___  ___  ___  ___  ___   ___        NAV_UP_PC     NAV_LEFT_PC   NAV_RIGHT_PC   NAV_DOWN_PC  ___ 
___  ___  ___  ___  ___  ___ , ___        ___           ___           ___            ___          ___
___  ___  ___  ___  ___      ,            ___           ___           ___            ___          ___
,              ___  ___  ___   ___        ___           ___ 
,              ___  ___  ___   ___        ___           &swapper_pc   
)

MACRO(dot_dot, &macro_tap &kp DOT &kp DOT)

GLV80_LAYER(sym,
&none      &none      &none      &none      &none                             &none      &none      &none        &none     &none
&kp GRAVE  &kp RBKT   &kp LPAR   &kp RPAR   &kp SEMI   &kp DOT     &none      &none      &none      &none        &none     &none
&kp LBKT   &kp EXCL   &kp LBRC   &kp RBRC   &kp COMMA  &kp QMARK   &kp GRAVE  &kp SPC    &kp BSPC   &kp TAB      &kp DEL   &none
&kp HASH   &kp CARET  &kp EQUAL  &kp UNDER  &kp DLLR   &kp STAR    &kp DQT    &sk LCTRL  &sk LSHFT  &sk LALT     &sk LGUI  &none
&kp TILDE  &kp LT     &kp PIPE   &kp MINUS  &kp GT     &kp FSLH  , &kp SQT    &kp RET    &kp ESC    &kp LS(TAB)  &kp INS   &none
&dot_dot   &kp AMPS   &kp SQT    &kp DQT    &kp PLUS             ,            &none      &none      &none        &none     &none
,                                &kp BSLH   &kp DOT    &kp STAR    &none      &none      &none
,                                &kp PRCNT  &kp COLON  &kp AT      &none      &none      &none
)

GLV80_LAYER(num,
XXX  XXX  XXX  XXX  XXX             XXX  XXX  XXX  XXX  XXX
XXX  XXX  XXX  XXX  XXX  XXX   XXX  XXX  XXX  XXX  XXX  XXX
XXX  XXX  XXX  XXX  XXX  XXX   XXX  XXX  XXX  XXX  XXX  XXX
XXX  XXX  XXX  XXX  XXX  XXX   XXX  XXX  XXX  XXX  XXX  XXX
XXX  XXX  XXX  XXX  XXX  XXX , XXX  XXX  XXX  XXX  XXX  XXX
XXX  XXX  XXX  XXX  XXX      ,      XXX  XXX  XXX  XXX  XXX
,              ___  ___  ___   ___  ___  ___
,              ___  ___  ___   ___  ___  ___
)

GLV80_LAYER(sys,
XXX  XXX  XXX  XXX  XXX                             XXX    XXX    XXX    XXX           XXX
XXX  XXX  XXX  XXX  XXX  XXX           XXX          XXX    XXX    XXX    XXX           XXX
XXX  XXX  XXX  XXX  XXX  XXX           XXX          XXX    XXX    XXX    XXX           XXX
XXX  XXX  XXX  XXX  XXX  XXX           &bt BT_CLR   &bt_0  &bt_1  &bt_2  &out OUT_USB  XXX
XXX  XXX  XXX  XXX  XXX  &bootloader , &bootloader  XXX    XXX    XXX    XXX           XXX
XXX  XXX  XXX  XXX  XXX              ,              XXX    XXX    XXX    XXX           XXX
,              ___  ___  ___           ___  ___  ___
,              ___  ___  ___           ___  ___  ___
)